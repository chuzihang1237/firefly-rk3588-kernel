// SPDX-License-Identifier: (GPL-2.0+ OR MIT)
/*
 * Copyright (c) 2023 Rockchip Electronics Co., Ltd.
 *
 */

/dts-v1/;

#define FF_LEDS
#define FF_FAN
#define FF_WIFI_BT
#define FF_HDMI0
#define FF_DP0
#define FF_DSI1
//#define FF_DSI0
#define FF_SDCARD
#define FF_PCA953X
#define FF_TYPEC0
#define FF_USB30
#define FF_USB20_HOST0
#define FF_CODEC_ES8388
#define FF_4G_5G_MODULE
#define FF_GMAC1
#define FF_SATA0 // M.2 slot, mux with pcie2x1l2
#define FF_RECOVERY_KEY
#define FF_RTC
#define FF_RS232
#define FF_RS485
#define FF_CAN2

#include "rk3588-firefly-aio-3588sjd4.dtsi"
#include "rk3588-firefly-aio-3588sjd4-cam-8ms1m.dtsi" // Use 8MS1M (800w px camera x 1)
#include "rk3588-firefly-aio-3588sjd4-cam-dcphy-8ms1m.dtsi" // Use 8MS1M (800w px camera x 1)
//#include "rk3588-firefly-aio-3588sjd4-cam-2ms2mf.dtsi" // Or use 2MS1MF (200w px camera x 2)

#if defined FF_DSI0 && !defined(FF_DSI1)
#define WHICHDSI 0
#include "rk3588-firefly-aio-3588sjd4-mipi101-BSD1218-A101KL68.dtsi" // 10.1 inch mipi touchscreen
//#include "rk3588-firefly-aio-3588sjd4-mipi101-M101014-BE45-A1.dtsi" // 10.1 inch mipi touchscreen
#endif

#if defined FF_DSI1 && !defined(FF_DSI0)
#define WHICHDSI 1
#include "rk3588-firefly-aio-3588sjd4-mipi101-BSD1218-A101KL68.dtsi" // 10.1 inch mipi touchscreen
//#include "rk3588-firefly-aio-3588sjd4-mipi101-M101014-BE45-A1.dtsi" // 10.1 inch mipi touchscreen
#endif
/ {
	model = "Firefly AIO-3588SJD4";
	compatible = "rockchip,aio-3588sjd4", "rockchip,rk3588";
};

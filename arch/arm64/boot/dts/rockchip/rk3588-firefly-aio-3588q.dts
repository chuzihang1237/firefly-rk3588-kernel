// SPDX-License-Identifier: (GPL-2.0+ OR MIT)
/*
 * Copyright (c) 2023 Rockchip Electronics Co., Ltd.
 *
 */

/dts-v1/;
#define rk3588

#define FF_RECOVERY_KEY
#define FF_LEDS
#define FF_FAN
#define FF_WIFI_BT
#define FF_HDMI0
#define FF_VGA
#define FF_PCA953X
#define FF_WATCHDOG
#define FF_GMAC0
#define FF_GMAC1
#define FF_USB20_HOST0	//usb2.0 hub
#define FF_USB30_OTG1	//USB 3.0
#define FF_USB20_HOST1
#define FF_USB30_HOST
#define FF_TYPEC0
#define FF_DP0
#define FF_CAN1
#define FF_SDCARD
//#define FF_SATA0	// M.2 slot, mux with pcie2x1l2
#define FF_PCIE2_1L2	// M.2 slot, mux with sata2
#define FF_RTC
#define FF_RS232
#define FF_RS485
#define FF_SPI1
#define FF_CAM_8MS1M
#define FF_CAM_IMX415
#define FF_PCIE3_X4
#define FF_4G_5G_MODULE
#define FF_HDMI_RX
#define FF_CODEC_ES8388
#define FF_DSI0_V2
//#define FF_DSI1_V2
//#define FF_EDP

#include "rk3588-firefly-aio-3588q.dtsi"

#if defined(FF_DSI0_V2) && !defined(FF_DSI1_V2)
#define WHICHDSI 0
#include "rk3588-firefly-aio-3588q-mipi101-BSD1218-A101KL68.dtsi"
//#include "rk3588-firefly-aio-3588q-mipi101-M101014-BE45-A1.dtsi"
#endif

#if defined(FF_DSI1_V2) && !defined(FF_DSI0_V2)
#define WHICHDSI 1
#include "rk3588-firefly-aio-3588q-mipi101-BSD1218-A101KL68.dtsi"
//#include "rk3588-firefly-aio-3588q-mipi101-M101014-BE45-A1.dtsi"
#endif

#if defined(FF_DSI1_V2) && defined(FF_DSI0_V2)
#include "rk3588-firefly-aio-3588q-dual-mipi101-M101014-BE45-A1.dtsi"
#endif

#if defined(FF_EDP) && !defined(FF_DSI0_V2)
#include "rk3588-firefly-aio-3588q-edp_NV156FHM-T06.dtsi"
#endif

#ifdef FF_CAM_8MS1M
#include "rk3588-firefly-aio-3588q-cam0-8ms1m.dtsi"
#endif

#ifdef FF_CAM_IMX415
#include "rk3588-firefly-aio-3588q-cam0-imx415.dtsi"
#endif

/ {
	model = "Firefly AIO-3588Q";
	compatible = "rockchip,aio-3588Q", "rockchip,rk3588";
};

// SPDX-License-Identifier: (GPL-2.0+ OR MIT)
/*
 * Copyright (c) 2023 Rockchip Electronics Co., Ltd.
 *
 */

/dts-v1/;
#define rk3588

#define FF_RECOVERY_KEY
#define FF_LEDS
#define FF_FAN
#define FF_HDMI0
#define FF_HDMI1
#define FF_WATCHDOG
#define FF_GMAC0
#define FF_USB20_HOST0	//usb2.0 hub
#define FF_USB30_OTG1	//USB 3.0
#define FF_USB20_HOST1
#define FF_USB30_HOST
#define FF_TYPEC0
#define FF_DP0
#define FF_SDCARD
#define FF_PCIE2_1L0	// for wifi/bt
#define FF_SATA0	// M.2 slot, mux with pcie2x1l2
//#define FF_PCIE2_1L2	// M.2 slot, mux with sata2
#define FF_RTC
#define FF_UART3
#define FF_UART6
#define FF_UART7
#define FF_UART8
#define FF_SPI1
#define FF_CAM_8MS1M
//#define FF_PCIE3_X4
#define FF_4G_MODULE
#define FF_HDMI_RX
#define FF_CODEC_ES8388
#define FF_DSI0_V3
//#define FF_DSI1_V3
#define FF_CAM0_IMX415
//#define FF_CAM1_IMX415
//#define FF_CAM0_IMX586
//#define FF_CAM1_IMX586



#include "rk3588-firefly-aio-3588l.dtsi"

#ifdef FF_CAM_8MS1M
#include "rk3588-firefly-aio-3588l-cam0-8ms1m.dtsi"
#include "rk3588-firefly-aio-3588l-cam1-8ms1m.dtsi"
#endif

#ifdef FF_CAM0_IMX415
#include "rk3588-firefly-aio-3588l-cam0-imx415.dtsi"
#endif

#ifdef FF_CAM1_IMX415
#include "rk3588-firefly-aio-3588l-cam1-imx415.dtsi"
#endif

#ifdef FF_CAM0_IMX586
#include "rk3588-firefly-aio-3588l-cam0-imx586.dtsi"
#endif

#ifdef FF_CAM1_IMX586
#include "rk3588-firefly-aio-3588l-cam1-imx586.dtsi"
#endif

#if defined(FF_DSI0_V3) && !defined(FF_DSI1_V3)
#include "rk3588-firefly-aio-3588l-dsi0-mipi101-BSD1218-A101KL68.dtsi"
#endif

#if defined(FF_DSI1_V3) && !defined(FF_DSI0_V3)
#include "rk3588-firefly-aio-3588l-dsi1-mipi101-BSD1218-A101KL68.dtsi"
#endif

/ {
	model = "Firefly AIO-3588L";
	compatible = "rockchip,aio-3588l", "rockchip,rk3588";
};

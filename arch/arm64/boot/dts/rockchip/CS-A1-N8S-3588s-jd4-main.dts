// SPDX-License-Identifier: (GPL-2.0+ OR MIT)
/*
 * Copyright (c) 2023 Rockchip Electronics Co., Ltd.
 *
 */

/dts-v1/;

#define FF_LEDS
#define FF_FAN
#define FF_HDMI0
#define FF_SDCARD
#define FF_PCA953X
#define FF_TYPEC0
#define FF_USB30
#define FF_USB20_HOST0
#define FF_GMAC1
#define FF_RTC
#define FF_OTHER
#define FF_WK2XXX
#define FF_SUB_CORE_PCA953X
#define FF_WATCHDOG

#include "CS-A1-N8S-3588s-jd4-main.dtsi"

/ {
	model = "Firefly CS-A1-N8S-rk3588s-jd4 HDMI(Linux)";
	compatible = "rockchip,aio-3588sjd4", "rockchip,rk3588";
};
